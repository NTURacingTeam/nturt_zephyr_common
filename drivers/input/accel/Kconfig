## subsys/cmd/Kconfig
```kconfig
menuconfig NTURT_CMD
	bool "Commmand support"
	depends on NTURT
	select MPSC_PBUF
	select SYS_HASH_FUNC32
	select SYS_HASH_MAP

if NTURT_CMD

module = NTURT_CMD
module-str = Command
source "subsys/logging/Kconfig.template.log_config"

config NTURT_CMD_INIT_PRIORITY
	int "Init priority"
	default 50
	help
	  Command initialization priority.

config NTURT_CMD_BUF_SIZE
	int "Command buffer size"
	default 256

config NTURT_CMD_PROCESS_THREAD_STACK_SIZE
	int "Command processing thread stack size"
	default 512

config NTURT_CMD_PROCESS_THREAD_PRIORITY
	int "Command processing thread priority"
	default 1

endif # NTURT_CMD
```

## subsys/err/Kconfig
```kconfig
menuconfig NTURT_ERR
	bool "Error passing and handling support"
	depends on NTURT
	select SYS_HASH_FUNC32
	select SYS_HASH_MAP

if NTURT_ERR

module = NTURT_ERR
module-str = Error Handling
source "subsys/logging/Kconfig.template.log_config"

config NTURT_ERR_INIT_PRIORITY
	int "Init priority"
	default 0
	help
	  Error initialization priority.

config NTURT_ERR_CB_DISPATCH_PRIORITY
	int "Init priority to start processing error callbacks"
	default 90
	help
	  Error callback dispatch priority after which the error callbacks will be
	  processed. Callbacks with errors set before this priority will be deferred
	  until this priority is reached.

config NTURT_ERR_SHELL
	bool "Error shell support"
	depends on NTURT_SHELL
	default y

endif # NTURT_ERR
```

## subsys/front_box/Kconfig
```kconfig
menuconfig NTURT_FRONT_BOX_API
    bool "Front box API"
    depends on NTURT

if NTURT_FRONT_BOX_API

config NTURT_FB_DASH_LEDS
    bool "Front box APIs"
    depends on DT_HAS_NTURT_DASH_LEDS_ENABLED && NTURT_MSG_SDO_CLI
    default y

endif # NTURT_FRONT_BOX_API
```

## subsys/msg/Kconfig
```kconfig
menuconfig NTURT_MSG
	bool "Inter-thread communication support"
	depends on NTURT
	select ZBUS
	select ZBUS_CHANNEL_NAME

if NTURT_MSG

module = NTURT_MSG
module-str = Inter-thread Communication
source "subsys/logging/Kconfig.template.log_config"

config NTURT_MSG_INIT_PRIORITY
	int "Init priority"
	default 10
	help
	  Inter-thread communication initialization priority.

config NTURT_MSG_MAX_SIZE
	int "Maximum message size"
	default 256
	help
	  Maximum size of a message used to create buffers of the right size.
	  Increase when appropriate.

config NTURT_MSG_LOGGING
	bool "Message logging support"
	depends on NTURT_FS
	default y
	select ZBUS_RUNTIME_OBSERVERS

if NTURT_MSG_LOGGING

config NTURT_MSG_LOGGING_BUF_SIZE
	int "Logging buffer size"
	default 4096
	help
	  Size of the buffer used for logging messages in bytes.

endif # NTURT_MSG_LOGGING

config NTURT_MSG_SHELL
	bool "Message shell support"
	depends on NTURT_SHELL
	default y
	select CBPRINTF_FP_SUPPORT
	select ZBUS_CHANNEL_PUBLISH_STATS
	select ZBUS_RUNTIME_OBSERVERS

endif # NTURT_MSG
```

## subsys/rear_box/Kconfig
```kconfig
menuconfig NTURT_REAR_BOX_API
    bool "Rear box APIs"
    depends on NTURT
    depends on NTURT_MSG_SDO_CLI
    help
      Enable APIs to control rear box

if NTURT_REAR_BOX_API

endif # NTURT_REAR_BOX_API
```
