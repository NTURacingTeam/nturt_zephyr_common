## drivers/input/accel/Kconfig
```kconfig
menuconfig INPUT_ACCEL
	bool "Accelerator input device comforming to the FSAE rules"
	depends on DT_HAS_NTURT_ACCEL_ENABLED
	default y
	help
	  Enable driver for accelerator input device to conform to FSAE rule EV4.7,
	  APPS / Brake Pedal Plausibility Check.

if INPUT_ACCEL

endif # INPUT_ACCEL
```

## drivers/input/sensor-axis/Kconfig
```kconfig
menuconfig INPUT_SENSOR_AXIS
    bool "Axis input device using data from sensors"
    depends on DT_HAS_SENSOR_AXIS_ENABLED && SENSOR
    default y
    help
      Enable driver for axis input device using data from sensors.

if INPUT_SENSOR_AXIS

config INPUT_SENSOR_AXIS_THREAD_STACK_SIZE
    int "Sensor axis processing thread stack size"
    default 1024
    help
      Thread stack size for sensor axis processing thread

config INPUT_SENSOR_AXIS_THREAD_PRIORITY
    int "sensor axis processing thread priority"
    default 0
    help
      Thread priority for sensor axis processing thread

config INPUT_SENSOR_AXIS_SETTINGS
	bool "Sensor axis settings support"
	depends on SETTINGS
	default y
	help
	  Support for saving calibration data for sensor axis. Exposes a
	  sensor_axis_calibration_save() function to save the calibration into
	  settings and load them automatically on startup.

endif # INPUT_SENSOR_AXIS
```

## drivers/led_strip/Kconfig.gpio
```kconfig
menuconfig LED_STRIP_GPIO
    bool "Array of LEDs controlled by GPIO as a single LED strip."
    default y
    depends on GPIO && DT_HAS_GPIO_LED_STRIP_ENABLED
    help
      Enable driver for GPIO controlled LED strip.

if LED_STRIP_GPIO

endif # LED_STRIP_GPIO
```

## drivers/led_strip/gpio/Kconfig
```kconfig
menuconfig LED_STRIP_GPIO
    bool "LEDs strip controlled by GPIO"
    depends on DT_HAS_GPIO_LED_STRIP_ENABLED
    default y
    select GPIO
    help
      Enable driver for LED strip controlled by GPIO.

if LED_STRIP_GPIO

endif # LED_STRIP_GPIO
```

## drivers/sensor/Kconfig
```kconfig
if SENSOR

rsource "amt21/Kconfig"
rsource "analog-generic-sensor/Kconfig"
rsource "hall-rpm/Kconfig"
rsource "jy901b/Kconfig"
rsource "p51-curr/Kconfig"
rsource "zx/Kconfig"

endif # SENSOR
```

## drivers/sensor/amt21/Kconfig
```kconfig
menuconfig AMT21
    bool "CUI Devices AMT21 series absolute encoders"
    default y
    depends on SERIAL && DT_HAS_CUI_AMT21_ENABLED
    help
      Enable driver for AMT21 series absolute encoder.

if AMT21

config AMT21_READ_TRIES
    int "Number of tries to fetch from AMT21"
    default 10
    help
      Number of tries to fetch from AMT21, at least 3 successful read is
      required so that the medium could be used as the truth value.

endif # AMT21
```

## drivers/sensor/analog-generic-sensor/Kconfig
```kconfig
menuconfig ANALOG_GENERIC_SENSOR
	bool "Generic analog sensor"
	depends on DT_HAS_ANALOG_GENERIC_SENSOR_ENABLED
	default y
	select ADC
	help
	  Enable driver for generic analog sensor.

if ANALOG_GENERIC_SENSOR

endif # ANALOG_GENERIC_SENSOR
```

## drivers/sensor/hall-rpm/Kconfig
```kconfig
menuconfig HALL_RPM
    bool "Hall-effect gear tooth speed sensor"
    depends on DT_HAS_HALL_RPM_ENABLED
    default y
    select GPIO
    help
      Enable driver for hall-effect gear tooth speed sensor.

if HALL_RPM

endif # HALL_RPM
```

## drivers/sensor/p51-curr/Kconfig
```kconfig
menuconfig P51_CURR
    bool "SSI Technologies P51 series pressure sensor with current output"
    depends on DT_HAS_SSI_P51_CURR_ENABLED
    default y
    select ADC
    help
      Enable driver for P51 series pressure sensor.

if P51_CURR

endif # P51_CURR
```

## drivers/sensor/zx/Kconfig
```kconfig
menuconfig ZX
    bool "RES Instrument ZX series linear traveral sensor"
    depends on DT_HAS_RES_ZX_ENABLED
    default y
    select ADC
    help
      Enable driver for ZX series linear traveral sensor.

if ZX

endif # ZX
```

## dts/bindings/input/nturt,accel.yaml
```yaml
description: |
  Accelerator input device comforming to the FSAE rule EV4.7, APPS / Brake Pedal
  Plausibility Check. It takes both the input value from APPS and BSE from
  code INPUT_ABS_THROTTLE and INPUT_ABS_BRAKE, respectively. The final
  accelerator value will be reported by this device in INPUT_ABS_THROTTLE.

compatible: "nturt,accel"

include: base.yaml

properties:
  accel:
    type: phandle
    required: true
    description: |
      Accelerator input device.

  brake:
    type: phandle
    required: true
    description: |
      Brake input device.

  min:
    type: int
    default: 0
    description: |
      Minimum value of both input and output.

  max:
    type: int
    default: 100
    description: |
      Maximum value of both input and output.
```

## dts/bindings/input/sensor-axis.yaml
```yaml
description: |
  Sesnor based axis input device.

  Implement an input device generating absolute axis events by periodically
  reading from sensors and optionally combines multiple sensors into a single
  axis event using weighted average.

  Offers deadzone and noise filters for primitive sensor data processing, as
  well as changing individual sensor input range during runtime and save the
  calibrations using settings subsystem. Range and deviation checks are also
  provided with optional time tolerance for data plausibility.

  Example configuration:

  #include <zephyr/dt-bindings/sensor/sensor-channels.h>
  #include <zephyr/dt-bindings/input/input-event-codes.h>
  #include <zephyr/dt-bindings/input/sensor-axis.h>

  sensor-axis {
      compatible = "senssor-axis";
      poll-period-ms = <10>;

      axis-x {
          zephyr,axis = <INPUT_ABS_X>;
          deadzone-mode = <INPUT_DEADZONE_MODE_EDGE>;
          deadzone-size = <5>; // 5%
          noise = <1000>; // 1%
          dev-tolerance = <10>; // 10%

          axis-x-0 {
              sensor = <&sensor0>;
              zephyr,channel = <SENSOR_CHAN_ROTATION>;
              in-min = <0 0>;
              in-max = <15 0>;
              range-tolerance = <10>; // 10%
          };

          axis-x-1 {
              sensor = <&sensor1>;
              zephyr,channel = <SENSOR_CHAN_ROTATION>;
              in-min = <15 0>;
              in-max = <0 0>;
              range-tolerance = <10>; // 10%
          };
      };
  };

compatible: "sensor-axis"

include: base.yaml

properties:
  poll-period:
    type: int
    default: 10
    description: |
      How often to get new sensor samples for the various axes in milliseconds.

child-binding:
  description: |
    Each axis this device controls.

  properties:
    zephyr,axis:
      type: int
      required: true
      description: |
        The input code that this axis will report, typically one of INPUT_ABS_*.
    out-min:
      type: int
      default: 0
      description: |
        Minimum value to output on input events.
    out-max:
      type: int
      default: 100
      description: |
        Maximum value to output on input events.
    deadzone-mode:
      type: int
      default: 0
      description: |
        The mode of deadzone. Can be either INPUT_DEADZONE_MODE_CENTER or
        INPUT_DEADZONE_MODE_EDGE. If CENTER is specified, sensor value within
        the center plus or minus the deadzone size will be reported as center.
        If EDGE is specified, sensor value within the minimum value plus the
        deadzone size will be reported as the minimum value.
      enum:
        - 0 # INPUT_DEADZONE_MODE_CENTER
        - 1 # INPUT_DEADZONE_MODE_EDGE
    deadzone-size:
      type: int
      default: 0
      description: |
        Deadzone size of the sensor in percentage. Set to 0 to disable deadzone.
        Note that if both noise and deadzone are enabled, the deadzone should be
        greater than noise.
    noise:
      type: int
      default: 0
      description: |
        Change in combined sensor value before a new input event is reported in
        one-millionth part. Set to 0 to disable noise filter.
        Note that if both noise and deadzone are enabled, the deadzone should be
        greater than noise.
    dev-tolerance:
      type: int
      default: -1
      description: |
        The tolerance of value deviation between any two sensors used in this
        axis in percentage. Set to -1 to disable deviation check.
    time-tolerance:
      type: int
      default: 0
      description: |
        Amount of time to wait in milliseconds before reporting this axis
        invalid due to out of range or deviation errors. During time tolerance
        no input will be reported. Set to 0 to disable time tolerance.
        Note that channel time tolerance does not affect sensor reporting
        errors.
    time-tolerance-decay:
      type: int
      default: 100
      description: |
        Decay rate of accumulated error time (accumulated_time -= time_tolerance 
        * decay_rate) in percentage when the axis passes all checks. It can be
        used to avoid sporadic successes mixed in the failures to be considered
        as valid. It is also used to clear the error once the accumulated error
        time has decayed to 0. Set to 100 to disable decay and immediately clear
        error once the axis passes all checks.

  child-binding:
    description: |
      Each sensor this axis combines into.
    properties:
      sensor:
        type: phandle
        required: true
        description: |
          The sensor to fetch data from.
      zephyr,channel:
        type: int
        required: true
        description: |
          The channel of the sensor to fetch data from.
      in-min:
        type: array
        required: true
        description: |
          Minimum value from the sensor that corresponds to minimum output
          value.
          The format is the same as struct sensor_value in <X Y>, where X is the
          integer part and Y is the one-millionth part.
      in-max:
        type: array
        required: true
        description: |
          Maximum value from the sensor that corresponds to maximum output
          value.
          The format is the same as struct sensor_value in <X Y>, where X is the
          integer part and Y is the one-millionth part.
      range-tolerance:
        type: int
        default: -1
        description: |
          Sensor value tolerance to go below minimum or above maximum before
          it's considered out of range in percentage. Clamp to value within
          the tolerance range. Set to -1 to disable range check.
      weight:
        type: int
        default: 1
        description: |
          The weight of this sensor channel in the final output.
```

## dts/bindings/sensor/analog-generic-sensor.yaml
```yaml
description: |
  Generic analog sensor. Linearly interpolates voltage to sensor value. Clamps
  the value for voltages within tolerance range or returns error if voltage is
  out of range.

  Example configuration:

  #include <zephyr/dt-bindings/sensor/sensor-channels.h>

  analog-generic-sensor {
      compatible = "analog-generic-sensor";
      io-channels = <&adc0 0>;
      zephyr,channel = <SENSOR_CHAN_ROTATION>;
      min-voltage = <0>;
      max-voltage = <3300>;
      min-value = <0 0>;
      max-value = <360 0>;
      tolerance = <5>;
  };

compatible: "analog-generic-sensor"

include: sensor-device.yaml

properties:
  io-channels:
    type: phandle-array
    required: true
    description: |
      The ADC channel connected to the sensor.
  zephyr,channel:
    type: int
    required: true
    description: |
      Sensor channel of this device.
  min-voltage:
    type: int
    required: true
    description: |
      Minimum voltage range in millivolts.
  max-voltage:
    type: int
    required: true
    description: |
      Maximum voltage range in millivolts.
  min-value:
    type: array
    required: true
    description: |
      Reported sensor value when min-voltage is read. The format is the same as
      sensor_value in <X Y>, where X is the integer part and Y is the one-
      millionth part.
  max-value:
    type: array
    required: true
    description: |
      Reported sensor value when max-voltage is read. The format is the same as
      struct sensor_value in <X Y>, where X is the integer part and Y is the
      one-millionth part.
  tolerance:
    type: int
    default: 5
    description: |
      Voltage tolerance to go below minimum or above maximum before it's
      considered out of range in percentage.
```

## dts/bindings/sensor/zephyr,sensing-phy-generic.yaml
```yaml
description: |
  Generic physical sensor for sensing subsystem.

compatible: "zephyr,sensing-phy-generic"

include: zephyr,sensing-phy-sensor.yaml

properties:
  fake-interval:
    type: boolean
    description: |
      Sensing subsystem uses SENSOR_ATTR_SAMPLING_FREQUENCY to set interval. If
      the underlying sensor does not support this attribute, this property can
      be set to true to fake the interval and prevent errors.
  fake-sensitivity:
    type: boolean
    description: |
      Sesning subsystem uses SENSOR_ATTR_HYSTERESIS to set sensitivity. If the
      underlying sensor does not support this attribute, this property can be
      set to true to fake the sensitivity and prevent errors.
```

## subsys/Kconfig
```kconfig
menu "Subsystems and OS Services"

rsource "canbus/Kconfig"
rsource "cmd/Kconfig"
rsource "err/Kconfig"
rsource "msg/Kconfig"
rsource "sensing/Kconfig"
rsource "sys/Kconfig"
rsource "telemetry/Kconfig"
rsource "usb/Kconfig"

endmenu
```

## subsys/canbus/Kconfig
```kconfig
menu "Controller Area Network (CAN) bus support"

rsource "canopen/Kconfig"

config NTURT_CAN_SHELL
	bool "CAN shell"
	depends on NTURT_SHELL
	default y
	select STATS
	select CAN_STATS
	select CAN_SHELL

endmenu
```

## subsys/canbus/canopen/Kconfig
```kconfig
menuconfig NTURT_CANOPEN
	bool "CANopen support"
	depends on NTURT
	select SYS_HASH_FUNC32
	select SYS_HASH_MAP
	select CAN
	select CAN_ACCEPT_RTR
	select CANOPEN
	select CANOPENNODE
	select NTURT_ERR

if NTURT_CANOPEN

module = NTURT_CANOPEN
module-str = CANopen
source "subsys/logging/Kconfig.template.log_config"

config CANOPENNODE_BITRATE
	default 1000

config NTURT_CANOPEN_INIT_PRIORITY
	int "Init priority"
	default 21
	help
	  CANopen initialization priority. Must be higher than Zephyr's CANopen
	  initialization priority.

config NTURT_CANOPEN_HB_CONS
	bool "CANopen consumer heartbeat time"
	default y
	help
	  Consume heartbeat of nodes defined in object dictionary 0x1016 and set
	  cooresponding error if the node is not in NMT operational state or the
	  heartbeat time is exceeded.

if NTURT_CANOPEN_HB_CONS

choice CANOPENNODE_HB_CONS
	default CANOPENNODE_HB_CONS_SINGLE_CALLBACK
endchoice

endif # NTURT_CANOPEN_HB_CONS

config NTURT_CANOPEN_TIME
	bool "CANopen TIME object"
	depends on NTURT_RTC
	default y
	select CANOPENNODE_TIME
	help
	  Set system time to the timestamp from CANopen when receiving TIME object
	  for the first time after system reboot.

config NTURT_CANOPEN_STORAGE
	bool "CANopen object dictionary storage"
	depends on SETTINGS
	default y
	select CANOPENNODE_STORAGE
	help
	  Enable support for storing the CANopen object dictionary to settings
	  subsystem.

config NTURT_CANOPEN_TM
	bool "CANopen telemetry support"
	depends on NTURT_TM
	default y
	help
	  Enable telemetry support for CANopen. This will allow CANopen to publish
	  telemetry data to TPDOs using `CANOPEN_TM_TO_TPDO_DEFINE`.

config NTURT_CANOPEN_MSG
	bool "CANopen inter-thread communication support"
	depends on NTURT_MSG
	default y
	help
	  Enable inter-thread communication support for CANopen. This will allow
	  CANopen to publish messages using `CANOPEN_OD_AGG_TO_MSG_DEFINE` based on
	  object dictionary writes.

# config NTURT_CANOPEN_SDO_CLI_BUF_SIZE
#     int "SDO client buffer size"
#     default 5
#     help
#       Number of concurrent SDO client request

config NTURT_CANOPEN_SHELL
	bool "CANopen shell"
	depends on NTURT_SHELL
	default y
	select NTURT_CAN_SHELL

endif # NTURT_CANOPEN
```
