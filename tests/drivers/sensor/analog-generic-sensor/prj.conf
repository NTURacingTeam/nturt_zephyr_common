## CMakeLists.txt
```
cmake_minimum_required(VERSION 3.20.0)

find_package(Zephyr REQUIRED HINTS $ENV{ZEPHYR_BASE})

project(telemetry LANGUAGES C)

zephyr_include_directories(
    include
)

target_sources(app PRIVATE 
    src/main.c
)
```

## prj.conf
```kconfig
# test
CONFIG_ZTEST=y
CONFIG_ZTEST_SHUFFLE=y

# compiler
CONFIG_DEBUG_OPTIMIZATIONS=y

# kernel
## debug
CONFIG_DEBUG=y
CONFIG_PRINTK=y

## drivers
CONFIG_SENSOR=y
```

## app.overlay
```dts
#include <zephyr/dt-bindings/sensor/sensor-channels.h>

#include "dt-settings.h"

/ {
    adc: adc-emul {
        compatible = "zephyr,adc-emul";
        nchannels = <1>;
        ref-internal-mv = <5000>;
        #io-channel-cells = <1>;
        #address-cells = <1>;
	    #size-cells = <0>;

        channel@0 {
            reg = <0>;
            zephyr,gain = "ADC_GAIN_1";
            zephyr,reference = "ADC_REF_INTERNAL";
            zephyr,vref-mv = <5000>;
            zephyr,acquisition-time = <ADC_ACQ_TIME_DEFAULT>;
            zephyr,resolution = <14>;
        };
    };

    sensor: analog-generic-sensor {
        compatible = "analog-generic-sensor";
        io-channels = <&adc 0>;
        zephyr,channel = <SENSOR_CHAN>;
        min-voltage = <MIN_VOLTAGE>;
        max-voltage = <MAX_VOLTAGE>;
        min-value = <MIN_VALUE 0>;
        max-value = <MAX_VALUE 0>;
        tolerance = <TOLARENCE>;
    };
};
```

## src/main.c
```c
// glibc includes
#include <math.h>
#include <stdbool.h>
#include <stddef.h>

// zephyr includes
#include <zephyr/device.h>
#include <zephyr/devicetree.h>
#include <zephyr/drivers/adc/adc_emul.h>
#include <zephyr/drivers/sensor.h>
#include <zephyr/ztest.h>

// project includes
#include "dt-settings.h"

#define VAL_TOL 0.005

#define VOLTAGE_RANGE (double)(MAX_VOLTAGE - MIN_VOLTAGE)
#define VALUE_RANGE (double)(MAX_VALUE - MIN_VALUE)

static const struct device* adc = DEVICE_DT_GET(DT_NODELABEL(adc));
static const struct device* sensor = DEVICE_DT_GET(DT_NODELABEL(sensor));

static bool value_equal(double a, double b) {
  return fabs((a - b) / VALUE_RANGE) < VAL_TOL;
}

ZTEST_SUITE(analog_generic, NULL, NULL, NULL, NULL, NULL);

ZTEST(analog_generic, test_range) {
  struct sensor_value value;

  for (int i = 0; i < 100; i++) {
    adc_emul_const_value_set(adc, 0, MIN_VOLTAGE + VOLTAGE_RANGE * i / 100);
    zassert_ok(sensor_sample_fetch(sensor));
    zassert_ok(sensor_channel_get(sensor, SENSOR_CHAN, &value));
    zassert_true(value_equal(sensor_value_to_double(&value),
                             MIN_VALUE + VALUE_RANGE * i / 100));
  }
}

ZTEST(analog_generic, test_clamp) {
  struct sensor_value value;

  adc_emul_const_value_set(adc, 0,
                           MIN_VOLTAGE - VOLTAGE_RANGE * (TOLARENCE - 1) / 100);
  zassert_ok(sensor_sample_fetch(sensor));
  zassert_ok(sensor_channel_get(sensor, SENSOR_CHAN, &value));
  zassert_equal(value.val1, MIN_VALUE);

  adc_emul_const_value_set(adc, 0,
                           MAX_VOLTAGE + VOLTAGE_RANGE * (TOLARENCE - 1) / 100);
  zassert_ok(sensor_sample_fetch(sensor));
  zassert_ok(sensor_channel_get(sensor, SENSOR_CHAN, &value));
  zassert_equal(value.val1, MAX_VALUE);
}

ZTEST(analog_generic, test_out_of_range) {
  adc_emul_const_value_set(adc, 0,
                           MIN_VOLTAGE - VOLTAGE_RANGE * (TOLARENCE + 1) / 100);
  zassert_not_ok(sensor_sample_fetch(sensor));

  adc_emul_const_value_set(adc, 0,
                           MAX_VOLTAGE + VOLTAGE_RANGE * (TOLARENCE + 1) / 100);
  zassert_not_ok(sensor_sample_fetch(sensor));
}
```

## include/dt-settings.h
```c
#ifndef DT_SETTINGS_H_
#define DT_SETTINGS_H_

#include <zephyr/dt-bindings/sensor/sensor-channels.h>

#define SENSOR_CHAN SENSOR_CHAN_ROTATION
#define MIN_VOLTAGE 500
#define MAX_VOLTAGE 4500
#define MIN_VALUE 0
#define MAX_VALUE 360
#define TOLARENCE 5

#endif /* DT_SETTINGS_H_ */
```
