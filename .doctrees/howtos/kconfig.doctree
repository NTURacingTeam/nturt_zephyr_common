## Kconfig.nturt
```kconfig
menuconfig NTURT
	bool "NTURT common library"
	help
	  Enables NTU Racing Team common library

if NTURT

module = NTURT
module-str = NTURT
source "subsys/logging/Kconfig.template.log_config"

endif # NTURT
```

## boards/nturt/ep6_vcu/Kconfig.defconfig
```kconfig
if BOARD_EP6_VCU

if DMA
config DCACHE
    default n
endif

if SDMMC_STM32
config SDMMC_STM32_HWFC
    default y
endif

if MIPI_DBI
config DMA
    default y
config SPI
    default y
config SPI_STM32_DMA
    default y
endif

if LOG_BACKEND_UART
config UART_ASYNC_API
    default y
config LOG_BACKEND_UART_ASYNC
    default y
endif

if SHELL_BACKEND_SERIAL
config UART_ASYNC_API
    default y
endif

endif # BOARD_EP6_VCU
```

## boards/nturt/ep6_vcu/board.yml
```yaml
board:
  name: ep6_vcu
  vendor: nturt
  revision:
    format: major.minor.patch
    default: 0.1.0
    revisions:
    - name: 0.1.0
  socs:
    - name: stm32h743xx
```

## boards/nturt/ep6_vcu/ep6_vcu_defconfig
```kconfig
# hardware
## core
CONFIG_ARM_MPU=y

## gpio
CONFIG_GPIO=y

## uart
CONFIG_SERIAL=y

## spi
CONFIG_SPI=y

# drivers
## clock
CONFIG_CLOCK_CONTROL=y

## pin
CONFIG_PINCTRL=y

# os services
## memory
CONFIG_HW_STACK_PROTECTION=y

## console
CONFIG_CONSOLE=y
CONFIG_UART_CONSOLE=y
```

## boards/nturt/ep7_vcu/Kconfig.defconfig
```kconfig
if BOARD_EP7_VCU

if DMA
config DCACHE
	default n
endif

if SDMMC_STM32
config SDMMC_STM32_HWFC
	default y
endif

ST_STM32_UART := st,stm32-uart

DT_CHOSEN_ZEPHYR_CONSOLE := zephyr,console
config LOG_BACKEND_REAL_UART
	bool
	depends on LOG_BACKEND_UART
	depends on $(dt_chosen_enabled,$(DT_CHOSEN_ZEPHYR_CONSOLE))
	depends on $(dt_chosen_has_compat,$(DT_CHOSEN_ZEPHYR_CONSOLE),$(ST_STM32_UART))
	default y

if LOG_BACKEND_REAL_UART
config UART_ASYNC_API
	default y
config LOG_BACKEND_UART_ASYNC
	default y
endif

DT_CHOSEN_ZEPHYR_SHELL_UART := zephyr,shell-uart
config SHELL_BACKEND_REAL_UART
	bool
	depends on SHELL_BACKEND_SERIAL
	depends on $(dt_chosen_enabled,$(DT_CHOSEN_ZEPHYR_SHELL_UART))
	depends on $(dt_chosen_has_compat,$(DT_CHOSEN_ZEPHYR_SHELL_UART),$(ST_STM32_UART))
	default y

if SHELL_BACKEND_REAL_UART
config UART_ASYNC_API
	default y
config SHELL_ASYNC_API
	default y
endif

DT_CHOSEN_NTURT_LED_STRIP := nturt,led-strip
if $(dt_chosen_enabled,$(DT_CHOSEN_NTURT_LED_STRIP))
config DMA
    default y
config SPI_STM32_DMA
    default y
endif

endif # BOARD_EP7_VCU
```

## boards/nturt/ep7_vcu/board.yml
```yaml
board:
  name: ep7_vcu
  vendor: nturt
  revision:
    format: major.minor.patch
    default: 0.1.0
    revisions:
    - name: 0.1.0
  socs:
    - name: stm32h743xx
```

## boards/nturt/rearbox/rearbox_defconfig
```kconfig
# hardware
## core
CONFIG_ARM_MPU=y

## gpio
CONFIG_GPIO=y

# drivers
## clock
CONFIG_CLOCK_CONTROL=y

## pin
CONFIG_PINCTRL=y

## uart
CONFIG_SERIAL=y

# os services
## memory
CONFIG_HW_STACK_PROTECTION=y

## console
CONFIG_CONSOLE=y
CONFIG_UART_CONSOLE=y
```

## drivers/Kconfig
```kconfig
menu "Device Drivers"

rsource "auxdisplay/Kconfig"
rsource "gpio/Kconfig"
rsource "input/Kconfig"
rsource "led_strip/Kconfig"
rsource "sensor/Kconfig"

endmenu
```

## drivers/auxdisplay/Kconfig.gpio_seg_display
```kconfig
menuconfig AUXDISPLAY_GPIO_SEG_DISPLAY
    bool "Seven segment displays controlled by gpio as auxiliary display"
    default y
    depends on GPIO && DT_HAS_GPIO_SEG_DISPLAY_ENABLED
    help
      Enable driver for seven segment displays controlled by gpio as auxiliary
      display

if AUXDISPLAY_GPIO_SEG_DISPLAY

endif # AUXDISPLAY_GPIO_SEG_DISPLAY
```

## drivers/auxdisplay/gpio-seg-display/Kconfig
```kconfig
menuconfig AUXDISPLAY_GPIO_SEG_DISPLAY
	bool "Seven segment displays controlled by GPIO as auxiliary display"
	depends on DT_HAS_GPIO_SEG_DISPLAY_ENABLED
	default y
	select GPIO
	select PWM if $(dt_compat_any_has_prop,gpio-seg-display,pwms)
	help
	  Enable driver for seven segment displays controlled by GPIO as auxiliary
	  display.

if AUXDISPLAY_GPIO_SEG_DISPLAY

endif # AUXDISPLAY_GPIO_SEG_DISPLAY
```

## drivers/gpio/74hc595/Kconfig
```kconfig
menuconfig GPIO_74HC595
    bool "Diodes Incorporated 74HC595 shift register as GPIO expander"
    depends on DT_HAS_DIODES_74HC595_ENABLED && SPI
    default y
    help
      Enable driver for 74HC595 shift register as GPIO expander.

if GPIO_74HC595

endif # GPIO_74HC595
```
