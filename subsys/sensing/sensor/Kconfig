## subsys/sensing/sensor/phy_generic/Kconfig
```kconfig
menuconfig SENSING_PHY_GENERIC
    bool "Generic physical sensor for sensing subsystem"
    default y
    depends on DT_HAS_ZEPHYR_SENSING_PHY_GENERIC_ENABLED
    help
      Enable driver for generic physical sensor for sensing subsystem.

if SENSING_PHY_GENERIC

config SENSING_PHY_GENERIC_THREAD_STACK_SIZE
    int "Underlying thread stack size"
    default 256
    help
      Stack size of the underlying thread for decoding read sensor data.

config SENSING_PHY_GENERIC_THREAD_PRIORITY
    int "Underlying thread priority"
    default 0
    help
      Priority of the underlying thread for decoding read sensor data.

config SENSING_PHY_GENERIC_RTIO_BLOCK_SIZE_PER_TYPE
    int "RTIO mempool block number per sensor type"
    default 8
    help
      Number of RTIO mempool block per sensor type. This driver internally uses
      sensor read and decode API for accessing the underlying sensor, which
      requires RTIO with mempool to store the read data. Internally the block
      size is 8 for both 32 and 64 bit compatibility, and number of block is
      this option times the total number of sensor types of devices compatible
      of "zephyr,sensing-phy-generic-sensor".

endif # SENSING_PHY_GENERIC
```

## subsys/sensors/Kconfig
```kconfig
menuconfig NTURT_SENSORS
    depends on NTURT
    bool "Sensor module"

if NTURT_SENSORS

config NTURT_SENSORS_INIT_PRIORITY
    int "Sensors subsystem initialization priority"
    default 10
    help
      Sensors subsystem initialization priority.

config NTURT_SENSORS_THREAD_PRIORITY
    int "Sensors subsystem thread priority"
    default 10
    help
      Sensors subsystem thread priority.

endif # NTURT_SENSORS
```

## subsys/sys/Kconfig
```kconfig
menuconfig NTURT_SYS
	bool "Basic system support"
	depends on NTURT
	select REBOOT
	imply POWEROFF

if NTURT_SYS

rsource "fs/Kconfig"
rsource "rtc/Kconfig"

module = NTURT_SYS
module-str = Basic System
source "subsys/logging/Kconfig.template.log_config"

config NTURT_SYS_INIT_PRIORITY
	int "Init priority"
	default 0
	help
	  Basic system initialization priority.

config NTURT_WORKQUEUE_STACK_SIZE
	int "Workqueue thread stack size"
	default 8192
	help
	  Stack size for the workqueue thread.

config NTURT_WORKQUEUE_THREAD_PRIORITY
	int "Workqueue thread priority"
	default 5
	help
	  Priority for the workqueue thread.

DT_CHOSEN_NTURT_BUZZER := nturt,buzzer
config NTURT_SYS_REBOOT_SOUND
	bool "Reboot sound"
	depends on $(dt_chosen_enabled,$(DT_CHOSEN_NTURT_BUZZER))
	default y
	select GPIO

config NTURT_SHELL
	bool "Shell support"
	select SHELL

if NTURT_SHELL

DT_CHOSEN_ZEPHYR_CONSOLE := zephyr,console
DT_CHOSEN_ZEPHYR_SHELL_UART := zephyr,shell-uart
config LOG_SHELL_DIFFERENT_BACKEND
	bool
	depends on $(dt_chosen_enabled,$(DT_CHOSEN_ZEPHYR_CONSOLE))
	depends on $(dt_chosen_enabled,$(DT_CHOSEN_ZEPHYR_SHELL_UART))
	depends on "$(dt_chosen_path,$(DT_CHOSEN_ZEPHYR_CONSOLE))" != \
		"$(dt_chosen_path,$(DT_CHOSEN_ZEPHYR_SHELL_UART))"
	default y
	help
	  Log default to use shell as the backend if both console and shell use
	  serial as the backend. This option makes the log output to correct serial
	  port if the console and shell use different serial ports.

if LOG_SHELL_DIFFERENT_BACKEND

config LOG_BACKEND_UART
	default y
config SHELL_LOG_BACKEND
	default n

endif # LOG_SHELL_DIFFERENT_BACKEND

config LOG_CMDS
	default y
config THREAD_RUNTIME_STATS
	default y

endif # NTURT_SHELL

endif # NTURT_SYS
```

## subsys/sys/Kconfig.rtc
```kconfig
config NTURT_SYS_RTC
    bool "Real-time clock system module"
    depends on RTC
    select POSIX_TIMERS
    help
      Initialize RTC time to dummy time if power had lost and set posix realtime
      clock time to RTC time. Implements function to set system time through
      sys_set_time().

if NTURT_SYS_RTC

config NTURT_LOG_REALTIME
    bool "Enable logging with real-time timestamp"
    default y
    select LOG_TIMESTAMP_USE_REALTIME
    help
      Use real-time clock time as logging system timestamp.

endif # NTURT_SYS_RTC
```

## subsys/sys/Kconfig.shell
```kconfig
config NTURT_SHELL
    bool "Shell module"
    depends on SHELL

if NTURT_SHELL

config NTURT_ALL_SHELL
    bool "Enable (almost) all useful shells from various subsystems"
    default y
    select THREAD_ANALYZER
    imply ADC_SHELL if ADC
    imply BBRAM_SHELL if BBRAM
    imply CAN_SHELL if CAN
    imply CHARACTER_FRAMEBUFFER_SHELL if CHARACTER_FRAMEBUFFER
    imply COUNTER_SHELL if COUNTER
    imply DAC_SHELL if DAC
    imply DEBUG_COREDUMP_SHELL if DEBUG_COREDUMP
    imply EEPROM_SHELL if EEPROM
    imply FILE_SYSTEM_SHELL if FILE_SYSTEM
    imply FILE_SYSTEM_SHELL_TEST_COMMANDS if FILE_SYSTEM
    imply FLASH_MAP_SHELL if FLASH_MAP
    imply FLASH_SHELL if FLASH
    imply GPIO_SHELL if GPIO
    imply HWINFO_SHELL if HWINFO
    imply I2C_SHELL if I2C
    imply INPUT_SHELL if INPUT
    imply LED_SHELL if LED
    imply PWM_SHELL if PWM
    imply RTC_SHELL if RTC
    imply SENSOR_SHELL if SENSOR
    imply SETTINGS_SHELL if SETTINGS
    imply SPI_SHELL if SPI
    imply STATS_SHELL if STATS

endif # NTURT_SHELL
```

## subsys/sys/fs/Kconfig
```kconfig
menuconfig NTURT_FS
	bool "File system support"
	select DISK_ACCESS
	select FILE_SYSTEM
	help
	  Automatically mount SD card to file system of choice.

if NTURT_FS

choice NTURT_FS_TYPE
	prompt "Which file system to use"
	default NTURT_FS_FAT_FS

config NTURT_FS_FAT_FS
	bool "Uses FatFs as the file system"
	select FAT_FILESYSTEM_ELM

config NTURT_FS_LITTLE_FS
	bool "Uses LittleFs as the file system"
	select FILE_SYSTEM_LITTLEFS
	select FS_LITTLEFS_BLK_DEV

endchoice

if NTURT_FS_FAT_FS

config FS_FATFS_REENTRANT
	default y
config FS_FATFS_FSTAB_AUTOMOUNT
	default y

config NTURT_FS_FAT_FS_HAS_RTC
	bool "Use real-time clock for FAT FS timestamps"
	depends on NTURT_RTC
	default y
	select FS_FATFS_HAS_RTC

endif # NTURT_FS_FAT_FS

config NTURT_FS_SHELL
	bool "File system shell"
	depends on NTURT_SHELL
	default y
	select FILE_SYSTEM_SHELL

if LOG

config LOG_BACKEND_FS
	default y
config LOG_BACKEND_FS_DIR
	default "/SD:/logs"
config LOG_BACKEND_FS_FILE_PREFIX
	default ""
config LOG_BACKEND_FS_FILES_LIMIT
	default 5
config LOG_BACKEND_FS_FILE_SIZE
	default 262144

endif # LOG

if SETTINGS

choice SETTINGS_BACKEND
	default SETTINGS_FILE
endchoice
config SETTINGS_FILE_PATH
	default "/SD:/settings"

config NTURT_SETTINGS_INIT_PRIORITY
	int "Init priority"
	default 99
	help
	  Settings subsystem initialization priority. Should be the last to load
	  settings to each module only after they are initialized.

endif # SETTINGS

endif # NTURT_FS
```

## subsys/sys/rtc/Kconfig
```kconfig
DT_CHOSEN_NTURT_RTC := nturt,rtc

menuconfig NTURT_RTC
	bool "Real-time clock support"
	depends on $(dt_chosen_enabled,$(DT_CHOSEN_NTURT_RTC))
	default y
	select RTC
	select POSIX_TIMERS
	help
	  Initialize RTC time to dummy time if power had lost and set posix realtime
	  clock time to RTC time. Implements function to set system time through
	  sys_set_time().

if NTURT_RTC

config NTURT_LOG_REALTIME
	bool "Enable logging with real-time timestamp"
	default y
	select POSIX_C_LANG_SUPPORT_R
	select LOG_TIMESTAMP_USE_REALTIME
	help
	  Use real-time clock time as logging system timestamp.

config NTURT_RTC_SHELL
	bool "Real-time clock shell"
	depends on NTURT_SYS_SHELL
	default y
	select RTC_SHELL

endif # NTURT_RTC
```

## subsys/telemetry/Kconfig
```kconfig
menuconfig NTURT_TM
	bool "Telemetry support"
	depends on NTURT
	depends on SYS_HASH_FUNC32
	depends on SYS_HASH_MAP
	select NTURT_MSG

if NTURT_TM

config NTURT_TM_INIT_PRIORITY
	int "Init priority"
	default 10
	help
	  Telemetry initialization priority.

endif # NTURT_TM
```

## subsys/usb/Kconfig
```kconfig
DT_CHOSEN_ZEPHYR_USB_DEVICE := zephyr,usb-device

menuconfig NTURT_USB
	bool "USB device support"
	depends on NTURT
	depends on $(dt_chosen_enabled,$(DT_CHOSEN_ZEPHYR_USB_DEVICE))
	select USB_DEVICE_STACK_NEXT
	imply HWINFO

if NTURT_USB

module = NTURT_USB
module-str = USB support
source "subsys/logging/Kconfig.template.log_config"

choice UDC_DRIVER_LOG_LEVEL_CHOICE
	default UDC_DRIVER_LOG_LEVEL_ERR
endchoice
choice USBD_LOG_LEVEL_CHOICE
	default USBD_LOG_LEVEL_ERR
endchoice

config NTURT_USB_INIT_PRIORITY
	int "Init priority"
	default 50
	help
	  USB support initialization priority.

config NTURT_USB_VID
	hex "USB Vendor ID"
	default 0x8000

config NTURT_USB_PID
	hex "USB Product ID"
	default 0x0000

config NTURT_USB_MANUFACTURER_STRING
	string "USB Manufacturer String"
	default "NTU Racing Team"

config NTURT_USB_PRODUCT_STRING
	string "USB Product String"
	default "Zephyr Common Library"

config NTURT_USB_CDC_ACM
	bool "USB CDC ACM support"
	depends on DT_HAS_ZEPHYR_CDC_ACM_UART_ENABLED
	default y
	select USBD_CDC_ACM_CLASS

if NTURT_USB_CDC_ACM

choice USBD_CDC_ACM_LOG_LEVEL_CHOICE
	default USBD_CDC_ACM_LOG_LEVEL_ERR
endchoice

endif # NTURT_USB_CDC_ACM

config NTURT_USB_MSC
	bool "USB MSC support"
	depends on NTURT_FS
	default y
	select USBD_MSC_CLASS

if NTURT_USB_MSC

choice USBD_MSC_LOG_LEVEL_CHOICE
	default USBD_MSC_LOG_LEVEL_ERR
endchoice

endif # NTURT_USB_MSC

endif # NTURT_USB
```

## tests/drivers/sensor/analog-generic-sensor/testcase.yaml
```yaml
common:
  tags:
    - drivers
    - sensor
    - analog-generic-sensor
  harness: ztest
  integration_platforms:
    - native_sim
tests:
  drivers.sensor.analog-generic-sensor: {}
  drivers.sensor.analog-generic-sensor.sanitizer:
    platform_allow:
      - native_sim
      - native_sim/native/64    
    extra_configs:
      - CONFIG_ASAN=y
      - CONFIG_UBSAN=y
```

## tests/subsys/cmd/testcase.yaml
```yaml
common:
  harness: ztest
  integration_platforms:
    - native_sim
  tags:
    - subsys
    - command
tests:
  subsys.command: {}
  subsys.command.sanitizer:
    platform_allow:
      - native_sim
      - native_sim/native/64
    extra_configs:
      - CONFIG_ASAN=y
      - CONFIG_UBSAN=y
```

## tests/subsys/err/testcase.yaml
```yaml
common:
  harness: ztest
  integration_platforms:
    - native_sim
  tags:
    - subsys
    - err
tests:
  subsys.msg: {}
  subsys.msg.sanitizer:
    platform_allow:
      - native_sim
      - native_sim/native/64
    extra_configs:
      - CONFIG_ASAN=y
      - CONFIG_UBSAN=y
```

## tests/subsys/telemetry/testcase.yaml
```yaml
common:
  harness: ztest
  integration_platforms:
    - native_sim
  tags:
    - subsys
    - telemetry
tests:
  subsys.telemetry: {}
  subsys.telemetry.sanitizer:
    platform_allow:
      - native_sim
      - native_sim/native/64
    extra_configs:
      - CONFIG_ASAN=y
      - CONFIG_UBSAN=y
```
